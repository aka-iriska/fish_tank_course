#include "oled_display.h"

/*
 * Буфер кадра (8 страниц по 128 сегментов размером 1 байт). static, чтобы он был виден только в этом файле.
 * Итого: 1024 Кб - половина от RAM Arduino
 */
static uint8_t page_buffer[SCREEN_WIDTH];
static uint8_t current_page = 0; // счётчик текущей страницы, принадлежит только этому файлу

const uint8_t courier_7x8_eng[] PROGMEM = {
    0x00, 0x00, 0x00, 0x00, 0x00, 0x00, 0x00, // Code for char
    0x00, 0x00, 0x00, 0x5F, 0x00, 0x00, 0x00, // Code for char !
    0x00, 0x00, 0x07, 0x00, 0x07, 0x00, 0x00, // Code for char "
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    0x00, 0x00, 0x03, 0x02, 0x03, 0x00, 0x00, // Code for char °
};

// Функция для отправки одной команды
void oled_send_command(uint8_t command)
{
    Wire.beginTransmission(SSD1306_ADDR);
    Wire.write(0x00); // Управляющий байт: "это команда"
    Wire.write(command);
    Wire.endTransmission();
}

// Функция для отправки данных в видеопамять
void oled_send_data(uint8_t *data, uint16_t size)
{
    // Wire.h имеет ограничение по объёму буфера передаваемых данных в 32 байта, чтобы не занимать много RAM
    uint16_t remaining = size;
    uint16_t offset = 0;

    // Loop until all data is sent
    while (remaining > 0)
    {
        Wire.beginTransmission(SSD1306_ADDR);
        Wire.write(0x40); // Control Byte: Data

        // Подсчитываем размер текущего блока
        // 31 байт данных, так как 1 уже занят 0x40
        uint8_t chunk_size = (remaining > (SSD1306_MAX_WRITE_SIZE - 1)) ? (SSD1306_MAX_WRITE_SIZE - 1) : remaining;

        // Отправляем блок данных в 32 байта
        for (uint8_t i = 0; i < chunk_size; i++)
        {
            Wire.write(data[offset + i]);
        }

        // Update remaining count and offset
        remaining -= chunk_size;
        offset += chunk_size;

        // End transmission for this chunk
        Wire.endTransmission();
    }
}

void oled_init()
{
    Wire.begin();

    oled_send_command(0xAE); // Выключить дисплей
    oled_send_command(0xD5); // !  Установить частоту тактового генератора
    oled_send_command(0x80); // ! Рекомендуемое значение
    oled_send_command(0xA8); // ! Установить мультиплексирование
    oled_send_command(0x3F); // ! Для 64 строк
    oled_send_command(0xD3); // ! Установить смещение дисплея
    oled_send_command(0x00); // ! Без смещения
    oled_send_command(0x40); // ! Установить начальную строку (0)
    oled_send_command(0x8D); // !  Настройки charge pump
    oled_send_command(0x14); // !  Включить charge pump
    oled_send_command(0x20); // Установить режим адресации памяти
    oled_send_command(0x00); // Горизонтальный режим
    oled_send_command(0xA1); // ! Перевернуть по горизонтали (segment remap)
    oled_send_command(0xC8); // ! Перевернуть по вертикали (COM output scan direction)
    oled_send_command(0xDA); // ! Настройки ножек COM
    oled_send_command(0x12); //
    oled_send_command(0x81); // ! Установить контрастность
    oled_send_command(0xCF); //
    oled_send_command(0xD9); // Установить pre-charge period
    oled_send_command(0xF1); //
    oled_send_command(0xDB); // Установить Vcomh
    oled_send_command(0x40); //
    oled_send_command(0xA4); // ! Отображать содержимое RAM
    oled_send_command(0xA6); // ! Нормальный (не инвертированный) режим
    oled_send_command(0xAF); // ! Включить дисплей

    Serial.println("[DEBUG] OLED is initialized!");
}

void oled_clear(){
    oled_clear_buffer();

    for (uint8_t page = 0; page < PAGE_COUNT; page++) {
        // Установить адрес страницы
        oled_send_command(0xB0 + page);  // страница 0–7
        oled_send_command(0x00);         // младший адрес столбца
        oled_send_command(0x10);         // старший адрес столбца

        // Записать 128 нулей в текущую страницу
        oled_send_data(page_buffer, 128);
    }
}

void oled_clear_buffer()
{
    memset(page_buffer, 0, sizeof(page_buffer)); // Очистка всего буфера
}

void oled_print_text(const char *text, int x, uint8_t page_index)
{
    oled_clear_buffer();

    if (page_index >= 0){
        current_page = page_index;
    }
    else
        page_index = 0;

    if (x < 0)
        x = 0;

    int current_x = x;
    while (*text)
    {
        oled_print_char(*text, current_x, page_index*PAGE_COUNT);
        current_x += 8; // Ширина символа (7) + 1 пиксель отступа
        text++;
    }

    current_page = (current_page + 1) % PAGE_COUNT;
    oled_update();
}


void oled_print_char(unsigned char c, int x, int y)
{
    if (c < 0x20 || c > 0x7F)
    {
        Serial.print("[ERROR] Skipping unsupported char: "); Serial.println(c, HEX);
        return;
    }
    uint16_t offset = (c - 0x20) * 7;

    for (uint8_t i = 0; i < 7; i++)
    {
        uint8_t line = pgm_read_byte(&courier_7x8_eng[offset + i]);
        for (uint8_t j = 0; j < 8; j++)
        {
            if ((line >> j) & 1)
            {
                oled_draw_pixel(x + i, y + j);
            }
        }
    }
}

void oled_draw_pixel(int x, int y)
{
    // Проверка выхода за границы
    if (x < 0 || x >= SCREEN_WIDTH || y < 0 || y >= SCREEN_HEIGHT)
        return;

    /*
     * x - индекс байта (сегмента) в странице
     * y/8 - индекс страницы
     * y/8 * 128 - количество байт выделенных на каждую страницу
     */

    // uint16_t byte_index = (y / PAGE_COUNT) * SCREEN_WIDTH + x;
    uint8_t bit_mask = 1 << (y % PAGE_COUNT);

    // Устанавливаем нужный бит в 1
    page_buffer[x] |= bit_mask;
}

void oled_update()
{
    // Команды для сброса "курсора" в начало видеопамяти
    oled_send_command(0x21);             // Установить диапазон столбцов
    oled_send_command(0);                // Начальный столбец
    oled_send_command(SCREEN_WIDTH - 1); // Конечный столбец

    oled_send_command(0x22);         // Установить диапазон страниц (строк)
    oled_send_command(current_page); // Начальная страница
    oled_send_command(current_page); // Конечная страница

    // Отправляем весь буфер
    oled_send_data(page_buffer, sizeof(page_buffer));
}

void oled_turnon(){
    oled_send_command(0xAF);  // Включить дисплей
}

void oled_turnoff(){
    oled_send_command(0xAE); // Отправить дисплей в сон
}